#include <SPI.h>
#include <Ethernet.h>
#include <Ultrasonic.h>
#include <Wire.h>
#include <SeeedOLED.h>
#include <avr/pgmspace.h>

//Define Labels for OLED
static const unsigned char FREE[] PROGMEM ={
  0xFF,0xFF,0xFF,0xFF,0xFF,0xFF,0xFF,0xFF,0xFF,0xFF,0xFF,0xFF,0xFF,0xFF,0xFF,0xFF,
  0xFF,0xFF,0xFF,0xFF,0xFF,0xFF,0xFF,0xFF,0xFF,0xFF,0xFF,0xFF,0xFF,0xFF,0xFF,0xFF,
  0xFF,0xFF,0xFF,0xFF,0xFF,0xFF,0xFF,0xFF,0xFF,0xFF,0xFF,0xFF,0xFF,0xFF,0xFF,0xFF,
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  0xFF,0xFF,0xFF,0xFF,0xFF,0xFF,0xFF,0xFF,0xFF,0xFF,0xFF,0xFF,0xFF,0xFF,0xFF,0xFF
};
static const unsigned char OCCUPIED[] PROGMEM ={
  0xFF,0xFF,0xFF,0xFF,0xFF,0xFF,0xFF,0xFF,0xFF,0xFF,0xFF,0xFF,0xFF,0xFF,0xFF,0xFF,
  0xFF,0xFF,0xFF,0xFF,0xFF,0xFF,0xFF,0xFF,0xFF,0xFF,0xFF,0xFF,0xFF,0xFF,0xFF,0xFF,
  0xFF,0xFF,0xFF,0xFF,0xFF,0xFF,0xFF,0xFF,0xFF,0xFF,0xFF,0xFF,0xFF,0xFF,0xFF,0xFF,
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  0xFF,0xFF,0xFF,0xFF,0xFF,0xFF,0xFF,0xFF,0xFF,0xFF,0xFF,0xFF,0xFF,0xFF,0xFF,0xFF
};

static const unsigned char RESERVED[] PROGMEM ={
  0xFF,0xFF,0xFF,0xFF,0xFF,0xFF,0xFF,0xFF,0xFF,0xFF,0xFF,0xFF,0xFF,0xFF,0xFF,0xFF,
  0xFF,0xFF,0xFF,0xFF,0xFF,0xFF,0xFF,0xFF,0xFF,0xFF,0xFF,0xFF,0xFF,0xFF,0xFF,0xFF,
  0xFF,0xFF,0xFF,0xFF,0xFF,0xFF,0xFF,0xFF,0xFF,0xFF,0xFF,0xFF,0xFF,0xFF,0xFF,0xFF,
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  0xFF,0xFF,0xFF,0xFF,0xFF,0xFF,0xFF,0xFF,0xFF,0xFF,0xFF,0xFF,0xFF,0xFF,0xFF,0xFF
};

//Define Sensors
Ultrasonic UltraSonic1(7); //Sensor unten
Ultrasonic UltraSonic2(8); //Sensor Oben


// Newer Ethernet shields have a MAC address printed on a sticker on the shield
byte mac[] = { 
  0x90, 0xA2, 0xDA, 0x0F, 0xBD, 0x5F };

IPAddress server(192,168,2,203);  // IP of the webserver to reach (use host ip if used in virtualbox)

IPAddress ip(192,168,2,200);      // IP of the arduino device (can be set to your needs)

// Initialize the Ethernet client library
// with the IP address and port of the server 
// that you want to connect to (port 80 is default for HTTP):
EthernetClient client;


boolean requestOngoing = false;
int sensorIsOccupied1 = 9; //in cm
int sensorIsOccupied2 = 15; //in cm
long initialStartTime = -1;
int firstStartDelay = 1000; 
int periodicDelay = 500;
long lastMillis = -1;
int serverCallDelay = 10000;
long lastTimeServerWasCalled = -1;
int parkingLotState = 0;
int parkingLotState2 = 1;



enum {
  IS_OCCUPIED = 1,
  IS_RESERVED = 2
};

void setup() {

  /* No Longer in Use
   *  pinMode(UltraSonic1, INPUT);
   *  pinMode(UltraSonic2, INPUT);
   */

  //Initialize LED Display
  Wire.begin();
  SeeedOled.init();  //initialze SEEED OLED display
  SeeedOled.clearDisplay();          //clear the screen and set start position to top left corner
  SeeedOled.setNormalDisplay();      //Set display to normal mode (i.e non-inverse mode)
  SeeedOled.setPageMode();           //Set addressing mode to Page Mode
  SeeedOled.setTextXY(0,0);          //Set the cursor to Xth Page, Yth Column  
  SeeedOled.putString("Initializing...");

  // Open serial communications and wait for port to open:
  Serial.begin(9600);

  Serial.println("Started");
  Ethernet.begin(mac, ip);

  // give the Ethernet shield a second to initialize:
  delay(1000);

  Serial.println("connecting...");
}


int sendHttpRequest(int sensor1Value, int sensor2Value, bool isOccupied) {
  requestOngoing = true;

  if (client.connect(server, 1337)) {
    Serial.println("connected");
    String buf = "";

    //char buf[100];
    buf += "sensor1=";
    buf += sensor1Value;
    buf += "&sensor2=";
    buf += sensor2Value;
    buf += "&isoccupied=";
    buf += isOccupied;
    
    //sprintf(buf + strlen(buf), "\"&sensor2\":%d",sensor2Value);
    //sprintf(buf + strlen(buf), "\"&isOccupied\":%d}",isOccupied);
    Serial.println(sensor1Value);
    Serial.println(sensor2Value);
    Serial.println(isOccupied);
    Serial.println(buf);
    Serial.println(buf.length());

    // Make a HTTP request:
    client.println("POST /sensordata HTTP/1.1");
    client.println("Host: 192.168.2.203:1337");
    client.println("Connection: keep-alive");
    client.println("Content-Type: application/json");
    client.print("Content-Length: ");
    client.println(buf.length());
    client.println();                                              // This empty line is needed as request body is always separated by an empty line
    client.println(buf);

    delay(1000);

    //char c = client.read();

    int readBuf = 0;
    String response = "";
    while(readBuf != -1) {
      readBuf = client.read();
      response += (char)readBuf;
    }
    int test = response.indexOf("state=")+6;
    int testend = (response.substring(test)).indexOf("\n");
    //Serial.println(testend);
    Serial.println("CheckpointStart");
    //Serial.println(test);
    int state = response.substring(test, test+testend).toInt();
    Serial.println(state);
    Serial.println("CheckpointEnd");
    //Serial.println(retVal);

    return state;                    
  } 
  else {
    Serial.println("connection failed");
  }

  return -1;
}

void setParkingLotState(bool areBothSensorsOccupied) {
  if(areBothSensorsOccupied == false && parkingLotState & IS_OCCUPIED)
    parkingLotState -= IS_OCCUPIED;
  else if (areBothSensorsOccupied == true && (parkingLotState & IS_OCCUPIED) == false)
    parkingLotState += IS_OCCUPIED;
}

bool computeAndSetOccupiedState(int sensor1Value, int sensor2Value)
{
  bool areBothSensorsOccupied = sensor1Value <= sensorIsOccupied1 && sensor2Value <= sensorIsOccupied2;
  return areBothSensorsOccupied;
}

void displayParkingLotState() {
  char color[10];

  if(parkingLotState2 != parkingLotState){
    parkingLotState2 = parkingLotState;
    SeeedOled.clearDisplay();
  
    if(parkingLotState & IS_OCCUPIED){
       SeeedOled.drawBitmap(OCCUPIED,1024);
    }
  
    else if(parkingLotState){
      SeeedOled.drawBitmap(RESERVED,1024);
    }
    else{
      SeeedOled.drawBitmap(FREE,1024);
    }
  }
}

void updateParkingLotState(long currentMillis)
{
  int sensor1Value = UltraSonic1.MeasureInCentimeters();
  int sensor2Value = UltraSonic2.MeasureInCentimeters();
  bool isOccupied = computeAndSetOccupiedState(sensor1Value, sensor2Value);
  setParkingLotState(isOccupied);

  if(currentMillis - lastTimeServerWasCalled >= serverCallDelay) {
    int serverParkingLotState = sendHttpRequest(sensor1Value, sensor2Value, isOccupied);
    if(serverParkingLotState != -1)
      parkingLotState = serverParkingLotState;  

    lastTimeServerWasCalled = millis();
  }

  displayParkingLotState();
}

void loop()
{
  // Get current timestamp
  unsigned long currentMillis = millis();

  if(initialStartTime == -1) {
    initialStartTime = currentMillis;
  } 
  else if(currentMillis - initialStartTime <= firstStartDelay) {
    // loop for the initial delay time

  } 
  else {

    if(lastMillis == -1 && lastTimeServerWasCalled == -1) {
      lastMillis = millis();
      lastTimeServerWasCalled = lastMillis;
    }

    if(currentMillis - lastMillis >= periodicDelay) {
      updateParkingLotState(currentMillis);
      lastMillis = millis();
    }     

    // if the server's disconnected, stop the client and unblock requests
    if (requestOngoing && !client.connected()) {
      Serial.println();
      Serial.println("disconnecting.");
      requestOngoing = false;
    }
  }

  client.stop();
  delay(10000); // Stability
}

